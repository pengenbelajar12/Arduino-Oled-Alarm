#include <ESP8266WiFi.h>
#include <Wire.h>
#include <Adafruit_GFX.h>
#include <Adafruit_SSD1306.h>
#include <NTPClient.h>
#include <WiFiUdp.h>
#include <EEPROM.h>

// KOnfigurasi Wifi 
const char* ssid = "--------";
const char* password = "-------"; 

// Input dan output pin
const int buzzer = D8;
const int btnMenu = D7;
const int btnInc = D6;
const int btnDec = D5;
const int btnSelect = D4;
const int pindah = D3;

// setting ntp client 
WiFiUDP  ntpUDP;
NTPClient timeClient(ntpUDP, "pool.ntp.org", 7 * 3600, 60000); // UTC+7 WIB

// Setting oled
#define SCREEN_I2C_ADDR 0x3C
#define SCREEN_WIDTH 128
#define SCREEN_HEIGHT 64
Adafruit_SSD1306 display(SCREEN_WIDTH, SCREEN_HEIGHT, &Wire, -1);
#define FRAME_DELAY (42)
#define FRAME_WIDTH  (48)
#define FRAME_HEIGHT (48)
#define FRAME_COUNT (sizeof(anim1)/sizeof(anim1[0]))
const byte PROGMEM anim1[][288] = {
  {0,0,0,0,0,0,0,0,0,0,0,0,0,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0,0},
  {0,0,0,0,0,0,0,0,0,0,0,0,0,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0,0},
  {0,0,0,0,0,0,0,0,0,0,0,0,0,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0,0},
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  {0,0,0,0,0,0,0,0,0,0,0,0,0,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0,0}
};

#define FRAME_COUNT (sizeof(anim2)/ sizeof(anim2[0]))
const byte PROGMEM anim2[][288] = {
  {0,0,0,0,0,0,0,0,0,0,0,0,0,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240,0},
  {0,0,0,0,0,0,0,0,0,0,0,0,0,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240,0},
  {0,0,0,0,0,0,0,0,0,0,0,0,0,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240,0},
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  {0,0,0,0,0,0,0,0,0,0,0,0,0,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240,0}
};
// variabel alrm 
int alarmjam = 0;
int alarmmenit = 0;
int setmenu = 0;
bool setalarm = false;
bool setbuzzer = false;

// variabel animasi 
int frame = 0;
int open = 0;
bool tampil1 = true;

// fungsi animasi 
void animasi() {
  int Hour = timeClient.getHours();
  int Minute = timeClient.getMinutes();
  int Second = timeClient.getSeconds();
  display.clearDisplay();

  if(tampil1){
  display.drawBitmap(40, 8, anim1[frame], FRAME_WIDTH, FRAME_HEIGHT, 1);
  display.display();
  delay(FRAME_DELAY);
  
  frame++;
  if(frame >= FRAME_COUNT){
    frame = 0;
    tampil1 = false;
  }
}
  else {
  display.drawBitmap(40, 8, anim2[open], FRAME_WIDTH, FRAME_HEIGHT, 1);
  display.display();
  delay(FRAME_DELAY);

  open++;
  if(open >= FRAME_COUNT){
    open = 0;
    tampil1 = true; 
  }
}
  // nyocoke jam ro alrm 
  if(setalarm && Hour == alarmjam && Minute == alarmmenit && Second == 0){
    setbuzzer  = true;
  }
  else if (Hour == alarmjam && Minute > alarmmenit ){
    setbuzzer = false;
  }
  
  // setting  buzzer alarm
  if(setbuzzer){
    digitalWrite(buzzer,HIGH);
    delay(100);
    digitalWrite(buzzer,LOW);
  }
  else{
    digitalWrite(buzzer,LOW);
  }
}

// fungsi alarm 
void alarm() {
  timeClient.update();
  int Hour = timeClient.getHours();
  int Minute = timeClient.getMinutes();
  int Second = timeClient.getSeconds();

  // masuk ke menu 
  if(digitalRead(btnMenu) == LOW){
     setmenu++;
     digitalWrite(buzzer,HIGH);
     delay(50);
     digitalWrite(buzzer,LOW);
     Serial.print(setmenu);
    if(setmenu >= 3 ) setmenu = 0;
    delay(300);
  }
  switch (setmenu){
  // set alaarm 1 = setting jam dan 2 = stting menit 
  case 1:
    if(digitalRead(btnInc) == LOW){ digitalWrite(buzzer,HIGH); delay(50); digitalWrite(buzzer,LOW); alarmjam = (alarmjam + 1)% 24; delay(200);}
    if(digitalRead(btnDec) == LOW){ digitalWrite(buzzer,HIGH); delay(50); digitalWrite(buzzer,LOW); alarmjam = (alarmjam - 1 + 24)% 24; delay(200);}
    break;
  case 2:
    if(digitalRead(btnInc) == LOW){ digitalWrite(buzzer,HIGH); delay(50); digitalWrite(buzzer,LOW); alarmmenit = (alarmmenit + 1)% 60; delay(200);}
    if(digitalRead(btnDec) == LOW){ digitalWrite(buzzer,HIGH); delay(50); digitalWrite(buzzer,LOW); alarmmenit = (alarmmenit - 1 + 60)% 60; delay(200);}
    break;
  }

  // setting alarm
  int akhirtekan = HIGH;
  if(digitalRead(btnSelect) == LOW && akhirtekan == HIGH){
    digitalWrite(buzzer,HIGH);
    delay(50); 
    digitalWrite(buzzer,LOW);
    setalarm = !setalarm;
    delay(300);
  }
  akhirtekan = digitalRead(btnSelect);

  // nyocoke jam ro alrm 
  if(setalarm && Hour == alarmjam && Minute == alarmmenit && Second == 0){
    setbuzzer  = true;
  }
  else if (Hour == alarmjam && Minute > alarmmenit ){
    setbuzzer = false;
  }
  
  // setting  buzzer alarm
  if(setbuzzer){
    digitalWrite(buzzer,HIGH);
    delay(100);
    digitalWrite(buzzer,LOW);
  }
  else{
    digitalWrite(buzzer,LOW);
  }

  // tampilkan di display
  display.clearDisplay();
  display.setTextSize(2);
  display.setTextColor(SSD1306_WHITE);

  // tampilkan alarm 
  display.setTextSize(1);
  display.setCursor(0, 35);
  display.print("Alarm: ");
  if (alarmjam < 10) display.print("0");
  display.print(alarmjam);
  display.print(":");
  if (alarmmenit < 10) display.print("0");
  display.print(alarmmenit);

  if(setalarm) display.print("  ON");
  else display.print("  OFF");

  // masuk mode apa?
  display.setCursor(0,50);
  if(setmenu == 0) display.print("OK ga kik? "); Serial.println("info 1");
  if(setmenu == 1) display.print("Setting jam"); Serial.println("info 2");
  if(setmenu == 2) display.print("Setting menit"); Serial.println("info 3");

  display.display();
}

// fungsi tampilin jam
void jam() {
  timeClient.update();
  int Hour = timeClient.getHours();
  int Minute = timeClient.getMinutes();
  int Second = timeClient.getSeconds();

    // nyocoke jam ro alrm 
  if(setalarm && Hour == alarmjam && Minute == alarmmenit && Second == 0){
    setbuzzer  = true;
  }
  else if (Hour == alarmjam && Minute > alarmmenit ){
    setbuzzer = false;
  }
  
  // setting  buzzer alarm
  if(setbuzzer){
    digitalWrite(buzzer,HIGH);
    delay(100);
    digitalWrite(buzzer,LOW);
  }
  else{
    digitalWrite(buzzer,LOW);
  }

  display.clearDisplay();
  display.setTextSize(2);
  display.setTextColor(SSD1306_WHITE);
  display.setCursor(18, 20);

  if (Hour < 10) display.print("0");
  display.print(Hour);
  display.print(":");
  if (Minute < 10) display.print("0");
  display.print(Minute);
  display.print(":");
  if (Second < 10) display.print("0");
  display.print(Second);

  display.display();
}
void setup() {
  // put your setup code here, to run once:
  pinMode(pindah,INPUT_PULLUP);
  pinMode(btnMenu,INPUT_PULLUP);
  pinMode(btnInc,INPUT_PULLUP);
  pinMode(btnDec,INPUT_PULLUP);
  pinMode(btnSelect,INPUT_PULLUP);
  pinMode(buzzer,OUTPUT);
  display.begin(SSD1306_SWITCHCAPVCC, SCREEN_I2C_ADDR);
  Serial.begin(115200);

  WiFi.begin(ssid, password);
  while (WiFi.status() != WL_CONNECTED){
    delay(400);
    display.clearDisplay();
    display.setTextSize(4);
    display.setTextColor(SSD1306_WHITE);
    display.setCursor(10,20);
    display.print(".");
    display.display();
  }
  display.clearDisplay();
    display.setTextSize(2);
    display.setTextColor(SSD1306_WHITE);
    display.setCursor(0,10);
    display.print("Wifi");
    display.setCursor(0,35);
    display.print("konek");
    display.display();
    delay(1000);
  // ntp
  timeClient.begin();
}

int kondisiakhir = HIGH;
int kondisialrm = HIGH;
bool modejam = false;
bool modealrm  = false;
int pindahan = 0;
void loop() {
int kondisi = digitalRead(pindah);
if(kondisi == LOW && kondisiakhir == HIGH){
  digitalWrite(buzzer, HIGH);
  delay(50);
  digitalWrite(buzzer,LOW);
  pindahan++;
  if (pindahan >= 3) pindahan = 0;
  Serial.println(pindahan);
  delay(200);
}
switch(pindahan){
  case 0:
    animasi();
    break;
  case 1:
    modejam = true;
    jam();
    break;
  case 2:
    modealrm = true;
    alarm();
    break;
}

kondisiakhir = kondisi;
}
